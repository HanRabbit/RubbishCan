/*
 Name:		HanRubbishCan.ino
 Created:	2021/6/28 20:10:19
 Author:	Han
*/
#include <Servo.h>
#include <Adafruit_GFX.h>
#include <Adafruit_SSD1306.h>
#include <Wire.h>
#include <EEPROM.h>

#define FM_PIN 3		//蜂鸣器端口
#define SERVO_PIN 7		//舵机端口

#define LIGHT_SENSOR_PIN 4	//光线传感器端口

#define SERVO_OPEN_ANGLE 30	//垃圾桶打开时的舵机角度
#define SERVO_CLOSE_ANGLE 128	//垃圾桶关闭时的舵机角度

#define SW_PIN 8	//按键端口
#define LED_PIN 11	//LED端口

/* EEPROM断电保存数据 */
#define EADDR_SERVO_SPEED 0		//servoSpeed保存地址
#define EADDR_RC_OPEN_TIME 1	///openTime保存地址

Adafruit_SSD1306 oled(128, 64, &Wire);	//创建OLED实例

Servo servo;	//创建Servo实例

//垃圾桶是否已经关闭 (0:关闭, 1:打开, 2:执行中)
int isOpen = 1;	

bool isTrigger = false;	//光线传感器是否触发
bool willOpen = false;
bool ctrlOpen = false;
int servoAngle = SERVO_OPEN_ANGLE;	//舵机角度初始化
int servoAngleTarget = SERVO_CLOSE_ANGLE;	//舵机目标

//垃圾桶状态动画显示标志位
int fAnim = (SERVO_CLOSE_ANGLE - SERVO_OPEN_ANGLE) / 6;

/* Servo舵机速度 */
int servoSpeed = 4;		//当前舵机速度
int SERVO_SPEED_MAX = 12;	//舵机最大速度
int SERVO_SPEED_MIN = 2;	//舵机最小速度

/* 垃圾桶张开时间 单位:循环 */
int openTime = 80;		//垃圾桶张开关闭的时间
int curOpenTime = 0;	//垃圾桶已经张开的时间
int OPEN_TIME_MAX = 150;
int OPEN_TIME_MIN = 50;

/* 按键 */
bool swIsDown = false;	//按键是否持续按下

bool keyDown = false;	//按键按下(一帧后初始化)
bool keyPress = false;	//按键长按(一帧后初始化)

bool swIsPress = false;	//按键是否长按

int curY = 16;		//滚动条当前Y坐标值
int tarCurY = 16;	//滚动条目标Y坐标值

int pressKeyNum = 16;	//长按按键计数超过此变量时，判断为长按
int curKeyNum = 0;		//当前长按按键计数

/* GUI */
int uiMode = 0;		//UI界面层级
int curSelect = 1;	//当前滚动条指向(1~3层)

/* Logo 取模数据 */
const unsigned char HAN_LOGO[] PROGMEM = { 
0x00,0x00,0x00,0x00,0x00,0x00,0x00,0x00,0x00,0x00,0x00,0x00,0x00,0x00,0x00,0x00,
0x00,0x00,0x00,0x00,0x00,0x00,0x00,0x00,0x00,0x00,0x00,0x00,0x00,0x00,0x00,0x00,
0x00,0x00,0x00,0x00,0x00,0x00,0x00,0x00,0x00,0x00,0x00,0x00,0x00,0x00,0x00,0x00,
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0x00,0x00,0x00,0x00,0x00,0x00,0x00,0x00,0x00,0x00,0x00,0x00,0x00,0x00,0x00,0x00 };

const unsigned char RUBBISH_LOGO[] PROGMEM = { 
0x00,0x00,0x00,0x00,0x00,0x00,0x00,0x00,0x00,0x00,0x00,0x00,0x00,0x00,0x00,0x00,
0x00,0x00,0x00,0x00,0x00,0x00,0x00,0x00,0x00,0x00,0x00,0x00,0x00,0x00,0x00,0x00,
0x00,0x00,0x00,0x00,0x00,0x00,0x00,0x00,0x00,0x00,0x00,0x00,0x00,0x00,0x00,0x00,
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0x00,0x00,0x00,0x00,0x00,0x00,0x00,0x00,0x00,0x00,0x00,0x00,0x00,0x00,0x00,0x00 };

/* 垃圾桶状态动画显示取模数据 */
// 32x53	共6帧
const unsigned char ANIM0[] PROGMEM = {
0x00,0x0F,0x00,0x00,0x00,0x71,0x7C,0x00,0x00,0xFD,0x7E,0x00,0x03,0xFD,0x7F,0x80,
0x07,0xFD,0x7F,0xC0,0x0F,0xFF,0x7F,0xE0,0x1F,0xFF,0x7F,0xF0,0x1F,0xFF,0x7F,0xF0,
0x3D,0xFF,0x7F,0xF8,0x7F,0xFF,0x7F,0xFC,0x7F,0xFF,0x7F,0xFC,0x7F,0xFF,0x7F,0xFC,
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0x7F,0xFF,0xFF,0xFC };
const unsigned char ANIM1[] PROGMEM = {
0x00,0x0F,0xF8,0x00,0x00,0x7F,0x88,0x00,0x00,0xFF,0xEA,0x00,0x03,0xFF,0xDB,0x80,
0x07,0xFF,0xFB,0xC0,0x0F,0xFF,0xF3,0xE0,0x1F,0xFF,0xF7,0xF0,0x1E,0xFF,0xF7,0xF0,
0x3F,0xFF,0xF7,0xF8,0x7F,0xFF,0xE7,0xFC,0x7F,0xFF,0xEF,0xFC,0x7F,0xFF,0xEF,0xFC,
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0x7F,0xFF,0xFF,0xFC };
const unsigned char ANIM2[] PROGMEM = {
0x00,0x0F,0xF8,0x00,0x00,0x7F,0xFC,0x00,0x00,0xFF,0xFE,0x00,0x03,0xFF,0xFF,0x80,
0x07,0xFF,0xFC,0xC0,0x0F,0xDF,0xFE,0xE0,0x1F,0xFF,0xFE,0xE0,0x1F,0xFF,0xFD,0xC0,
0x3F,0xFF,0xFF,0x98,0x3F,0xFF,0xFF,0x3C,0x3F,0xFF,0xFE,0x7C,0x0F,0xFF,0xFC,0xFC,
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0x7F,0xFF,0xFF,0xFC };
const unsigned char ANIM3[] PROGMEM = {
0x00,0x0F,0xF8,0x00,0x00,0x7F,0xFE,0x00,0x00,0xFF,0xFF,0x00,0x03,0xFB,0xFF,0x80,
0x07,0xFF,0xFF,0xC0,0x0F,0xFF,0xFF,0xE0,0x1F,0xFF,0xFF,0x30,0x0F,0xFF,0xFF,0x90,
0x07,0xFF,0xFF,0xD8,0x03,0xFF,0xFF,0x3C,0x01,0xFF,0xFF,0xF8,0x00,0xFF,0xFF,0xE2,
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0x7F,0xFF,0xFF,0xFC };
const unsigned char ANIM4[] PROGMEM = {
0x00,0x0F,0xFC,0x00,0x00,0x7F,0xFF,0x00,0x01,0xFF,0xFF,0x80,0x01,0xFF,0xBF,0xC0,
0x00,0xFF,0xFF,0xE0,0x00,0xFF,0xFF,0xE0,0x00,0x7F,0xFF,0xF0,0x00,0x7F,0xFF,0xF8,
0x00,0x3F,0xFF,0xF8,0x00,0x3F,0xFF,0xEC,0x00,0x1F,0xFF,0xF4,0x00,0x1F,0xFF,0xC6,
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0x7F,0xFF,0xFF,0xFC };
const unsigned char ANIM5[] PROGMEM = {
0x00,0x07,0xFC,0x00,0x00,0x0F,0xFF,0x00,0x00,0x0F,0xFF,0x80,0x00,0x0F,0xFF,0xC0,
0x00,0x0F,0xFF,0xE0,0x00,0x0F,0xFD,0xE0,0x00,0x0F,0xFF,0xF0,0x00,0x0F,0xFF,0xF8,
0x00,0x0F,0xFF,0xF8,0x00,0x0F,0xFF,0xEC,0x00,0x0F,0xFF,0xF4,0x00,0x0F,0xFF,0xF4,
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0x7F,0xFF,0xFF,0xFC };

//程序入口
void setup() {
	Serial.begin(115200);

	/* 初始化端口 */
	pinMode(LIGHT_SENSOR_PIN, INPUT);
	pinMode(SW_PIN, 0x1);	//	SW_PIN置下拉电阻
	pinMode(LED_PIN, OUTPUT);

	/* 初始化OLED显示屏 */
	oled.begin(SSD1306_SWITCHCAPVCC, 0x3C);
	/* 清空显示 */
	oled.clearDisplay();
	oled.display();

	delay(50);
	
	servo.attach(SERVO_PIN);	//初始化舵机
	operServoOpen(false);		//使垃圾桶缓慢关闭

	sysInit();		//系统初始化
}

void loop() {
	readLightSensorData();		//读取光线传感器状态
	readSWData();

	if(isTrigger || willOpen) {
		willOpen = true;
		operServoOpen(true);
	}
	if(!willOpen && !isTrigger) {
		operServoOpen(false);
	}

	drawMenu();		//显示部分
}

void sysInit() {
	pinMode(FM_PIN, OUTPUT);

	/* 蜂鸣器发声 */
	tone(FM_PIN, 500);
	delay(200);
	tone(FM_PIN, 600);
	delay(200);
	tone(FM_PIN, 800);
	delay(200);
	noTone(FM_PIN);

	servoSpeed = EEPROM.read(EADDR_SERVO_SPEED);
	openTime = EEPROM.read(EADDR_RC_OPEN_TIME);
	if(servoSpeed > SERVO_SPEED_MAX) 
		servoSpeed = 8;
	if(openTime > OPEN_TIME_MAX) 
		openTime = 80;

	/* OLED显示屏初始化 */
	displayInit();
}

void displayInit() {
	/* 绘制LOGO位图 */
	oled.clearDisplay();
	oled.drawBitmap(0, 0, HAN_LOGO, 128, 64, SSD1306_WHITE);
	oled.display();

	delay(2000);

	/* LOGO动画显示 */
	for (int y = 0; y > -64; y -= 12) {
		oled.clearDisplay();

		oled.drawBitmap(0, y, HAN_LOGO, 128, 64, SSD1306_WHITE);
		oled.drawBitmap(0, y + 64, RUBBISH_LOGO, 128, 64, SSD1306_WHITE);

		oled.display();
	}

	delay(2000);
}

void drawMenu() {
	oled.clearDisplay();

	/* 通过读取舵机当前角度来判断显示屏显示的垃圾桶状态 */
	if (servoAngle >= SERVO_OPEN_ANGLE && servoAngle < fAnim * 2) {
		oled.drawBitmap(5, 5, ANIM5, 32, 53, SSD1306_WHITE);
	} else if (servoAngle >= fAnim * 2 && servoAngle <= fAnim * 3) {
		oled.drawBitmap(5, 5, ANIM4, 32, 53, SSD1306_WHITE);
	} else if (servoAngle >= fAnim * 3 && servoAngle <= fAnim * 4) {
		oled.drawBitmap(5, 5, ANIM3, 32, 53, SSD1306_WHITE);
	} else if (servoAngle >= fAnim * 4 && servoAngle <= fAnim * 5) {
		oled.drawBitmap(5, 5, ANIM2, 32, 53, SSD1306_WHITE);
	} else if (servoAngle >= fAnim * 5 && servoAngle <= fAnim * 6) {
		oled.drawBitmap(5, 5, ANIM1, 32, 53, SSD1306_WHITE);
	} else if (servoAngle >= fAnim * 6 && servoAngle <= SERVO_CLOSE_ANGLE) {
		oled.drawBitmap(5, 5, ANIM0, 32, 53, SSD1306_WHITE);
	}

	// oled.drawBitmap(5, 5, ANIM0, 32, 53, SSD1306_WHITE);


	/* 绘制UI界面 */

	oled.setTextColor(SSD1306_WHITE);
	oled.setTextSize(1);

	oled.drawRect(0, 0, 128, 62, SSD1306_WHITE);

	oled.drawFastVLine(40, 15, 42, SSD1306_WHITE);

	oled.fillRect(40, 0, 88, 12, SSD1306_WHITE);
	oled.setTextColor(SSD1306_BLACK);

	oled.fillTriangle(40, 1, 40, 12, 52, 12, SSD1306_BLACK);

	if(uiMode == 0) {
		oled.setCursor(68, 3);
		oled.print("OPTION");
	} else if(uiMode == 1) {
		oled.setCursor(62, 3);
		oled.print("SITTINGS");
	}


	oled.setTextColor(SSD1306_WHITE);

	oled.setCursor(48, 18);
	if(uiMode == 0) {
		oled.print("Status:");
		if(isOpen == 0) {
			oled.print("Close");
		} else if(isOpen == 1) {
			oled.print("Open");
		} else {
			oled.print("---");
		}
	} 
	if(uiMode == 1) {
		oled.print("Speed:");
		oled.print(servoSpeed);
	}

	oled.drawFastHLine(48, 28, 55, SSD1306_WHITE);
	
	oled.setCursor(48, 32);
	if(uiMode == 0) {
		oled.print("Servo:");
		oled.print(servoAngle); 
	} else if(uiMode == 1) {
		oled.print("Open Time:");
		oled.print(openTime); 
	}

	oled.drawFastHLine(48, 42, 55, SSD1306_WHITE);

	oled.setCursor(48, 46);
	if(uiMode == 0) {
		oled.print("Sittings"); 
	} else if(uiMode == 1) {
		oled.print("Back");
	}

	step(&curY, &tarCurY, 6, 4);
	oled.fillRoundRect(43, curY, 3, 12, 2, SSD1306_WHITE);

	/* 长按按键触发事件 */
	if(keyPress) {
		if(uiMode == 0) {
			switch (curSelect) {
				case 1:
					ctrlOpen = true;
					isTrigger = !isTrigger;
					break;
				case 2:
					break;
				case 3:
					uiMode = 1;
					break;
			}
		} else if(uiMode == 1) {
			switch (curSelect) {
				case 1:
					step(&servoSpeed, &SERVO_SPEED_MAX, 2, 2);
					if(servoSpeed >= SERVO_SPEED_MAX) {
						servoSpeed = SERVO_SPEED_MIN;
					}
					EEPROM.write(EADDR_SERVO_SPEED, servoSpeed);
					break;
				case 2:
					step(&openTime, &OPEN_TIME_MAX, 20, 20);
					if(openTime >= OPEN_TIME_MAX) {
						openTime = OPEN_TIME_MIN;
					}
					EEPROM.write(EADDR_RC_OPEN_TIME, openTime);
					
					break;

				case 3:
					uiMode = 0;
					break;
			}
		}
	}
	oled.display();
}

/*
	控制舵机旋转角度和速度使垃圾桶打开或关闭

	[open]:希望垃圾桶打开或关闭
		true:打开
		flase:关闭
*/
void operServoOpen(bool open) {
	if(open) {
		servoAngleTarget = SERVO_OPEN_ANGLE;
	} else {
		servoAngleTarget = SERVO_CLOSE_ANGLE;
		curOpenTime++;
	}

	if(curOpenTime >= openTime || open) {
		if(step(&servoAngle, &servoAngleTarget, servoSpeed, servoSpeed)) {
			// 当前值 = 目标值	(已完成)
			if(open)
				isOpen = 1;
			else
				isOpen = 0;
			ctrlOpen = false;
			curOpenTime = 0;
			willOpen = false;
		} else {
			// 当前值 ≠ 目标值  (未完成)
			isOpen = 2;
		}
	}
	servo.write(servoAngle);
}

/*
	读取光线传感器数据
*/
void readLightSensorData() {
	if(!ctrlOpen) {
		if (digitalRead(LIGHT_SENSOR_PIN) == LOW) {
			isTrigger = true;
		}
		else {
			isTrigger = false;
		}
	}
}

/*
	读取按键数据
*/
void readSWData() {
	if(digitalRead(SW_PIN) == HIGH) {
		//当按键按下时
		swIsDown = true;
		curKeyNum ++;
		if(!swIsPress) {
			if(curKeyNum >= pressKeyNum) {
				keyPress = true;
				swIsPress = true;
			}
		} else {
			keyPress = false;
		}
	} else {
		if(curKeyNum < pressKeyNum && swIsDown && !swIsPress) {
			keyDown = true;
			swIsDown = false;
			curKeyNum = 0;
		} else {
			keyDown =false;
			keyPress = false;
		}

		swIsPress = false;
		swIsDown  = false;

		curKeyNum = 0;
	}


	if(keyDown && !swIsPress) {
		tarCurY += 14;
		curSelect ++;
		if(tarCurY > 44) {
			tarCurY = 16;
			curSelect = 1;
		}
		analogWrite(LED_PIN, 30);
	} else {
		analogWrite(LED_PIN, 0);
	}
}

/*
	步进函数:
		[cur]:当前变量[指针]
		[tar]:目标变量[指针]
		[step]:步进长度
		[acc]:精度
	返回值:
		[true]:步进完成(当前值 = 目标值)
		[false]:步进未完成，将等待下一轮步进(当前值 ≠ 目标值)
*/
bool step(int *cur, int *tar, int step, int acc) {
	// 当前值小于步进精度时，直接等于目标值
	if(abs(*cur - *tar) <= acc) {
		*cur = *tar;
		return true;
	}

	// 调整当前值
	if(*cur > *tar) {
		*cur -= step;
		return false;
	} else if(*cur < *tar) {
		*cur += step;
		return false;
	}
}